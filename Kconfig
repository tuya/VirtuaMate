## Kconfig
```kconfig
menu "configure app (VirtuaMate / Linux)"

    config SYS_BUS_OUTBOUND_STACK_SIZE
        int "SYS bus outbound thread stack size (bytes)"
        default 8192
        help
            Stack size in bytes for the SYS bus outbound thread (default 8*1024).

    config IM_BRIDGE_STACK_SIZE
        int "IM bridge thread stack size (bytes)"
        default 4096
        help
            Stack size in bytes for the IM bridge thread (default 4*1024).

config VIRTUAMATE_USE_AI_COMPONENTS
    bool
    default y
    select ENABLE_AI_COMPONENTS
    select ENABLE_AI_CHAT_CUSTOM_UI

config VIRTUAMATE_USE_EXT_RAM
    bool "Enable external PSRAM heap (SoC boards with PSRAM)"
    default n
    select ENABLE_EXT_RAM
    help
      Enable ENABLE_EXT_RAM so claw_malloc and im_calloc may use PSRAM.
      Leave disabled on Ubuntu/x64. Enable on boards that provide PSRAM.

rsource "./cron_service/Kconfig"
rsource "./gateway/Kconfig"
rsource "./IM/Kconfig"
rsource "./agent/Kconfig"
rsource "./components/lua/Kconfig"
rsource "./tools/Kconfig"

menu "VRM Viewer Config"

config VRM_MODEL_PATH
    string "3D model file path (VRM/PMX/GLB/FBX)"
    default ""
    help
      Path to the 3D model file to load.
      Supported formats: VRM, PMX, GLB, GLTF, FBX, OBJ, etc.
      Leave empty to disable the VRM viewer.

config VRM_ANIM_DIR
    string "VRMA animation directory (optional)"
    default ""
    help
      Path to a directory containing .vrma animation files.
      All .vrma files will be loaded and can be switched at runtime.
      Leave empty for no animation (static pose).

config VRM_WINDOW_WIDTH
    int "VRM viewer window width"
    default 1024

config VRM_WINDOW_HEIGHT
    int "VRM viewer window height"
    default 768

config VRM_FULLSCREEN
    bool "Start VRM viewer in fullscreen"
    default n

config VRM_SCENE_PARENT_DIR
    string "Scene parent directory (contains scene folders)"
    default ""
    help
      Parent directory scanned for scene sub-folders (2D image or cubemap skybox).
      At runtime the settings panel lists each sub-directory for selection.
      Default is no scene (gradient background) until the user picks one.

endmenu

endmenu
```

## cron_service/Kconfig
```kconfig
menu "Cron Service Config"
    config CRON_THREAD_STACK
        int "Cron thread stack size (bytes)"
        default 6144
        help
            Stack size in bytes for the cron scheduler thread (default 6*1024).
endmenu
```
